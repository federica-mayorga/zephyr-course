## app/boards/our_board/Kconfig.our_board
```kconfig
# Copyright (c) 2024 Nordic Semiconductor ASA
# SPDX-License-Identifier: Apache-2.0

config BOARD_OUR_BOARD
	select SOC_NRF54L05_CPUAPP if BOARD_OUR_BOARD_NRF54L05_CPUAPP
	select SOC_NRF54L10_CPUAPP if BOARD_OUR_BOARD_NRF54L10_CPUAPP || BOARD_OUR_BOARD_NRF54L10_CPUAPP_NS
	select SOC_NRF54L15_CPUAPP if BOARD_OUR_BOARD_NRF54L15_CPUAPP || BOARD_OUR_BOARD_NRF54L15_CPUAPP_NS
	select SOC_NRF54L15_CPUFLPR if BOARD_OUR_BOARD_NRF54L15_CPUFLPR || \
					    BOARD_OUR_BOARD_NRF54L15_CPUFLPR_XIP
```

## app/boards/our_board/board.yml
```yaml
board:
  name: our_board
  full_name: Our Board
  vendor: zephyr-course
  socs:
    - name: nrf54l05
    - name: nrf54l10
      variants:
        - name: ns
          cpucluster: cpuapp
    - name: nrf54l15
      variants:
        - name: xip
          cpucluster: cpuflpr
        - name: ns
          cpucluster: cpuapp
runners:
  run_once:
    '--recover':
      - runners:
          - nrfjprog
          - nrfutil
        run: first
        groups:
          - boards:
              - our_board/nrf54l15/cpuapp
              - our_board/nrf54l15/cpuapp/ns
              - our_board/nrf54l15/cpuflpr
              - our_board/nrf54l15/cpuflpr/xip
    '--erase':
      - runners:
          - nrfjprog
          - jlink
          - nrfutil
        run: first
        groups:
          - boards:
              - our_board/nrf54l15/cpuapp
              - our_board/nrf54l15/cpuapp/ns
              - our_board/nrf54l15/cpuflpr
              - our_board/nrf54l15/cpuflpr/xip
    '--reset':
      - runners:
          - nrfjprog
          - jlink
          - nrfutil
        run: last
        groups:
          - boards:
              - our_board/nrf54l15/cpuapp
              - our_board/nrf54l15/cpuapp/ns
              - our_board/nrf54l15/cpuflpr
              - our_board/nrf54l15/cpuflpr/xip
```

## app/boards/scratch_board/board.yml
```yaml
board:
  name: scratch_board
  full_name: Scratch Board
  vendor: zephyr-course
  socs:
    - name: nrf54l15
```

## app/drivers/subsys/led_sensor/Kconfig
```kconfig
menuconfig LED_SENSOR
	bool "Enable LED sensor driver"
	default y
	depends on DT_HAS_ZEPHYR_COURSE_LED_SENSOR_ENABLED
	select GPIO
	select SENSOR
	help
	  Out-of-tree sensor driver for the on-board LED.
	  sensor_sample_fetch turns the LED on; sensor_channel_get turns it off.

if LED_SENSOR

config LED_SENSOR_INIT_STATE
	bool "Start LED high at driver init"
	default n
	help
	  When enabled, the LED is driven high during led_sensor_init().

endif
```
